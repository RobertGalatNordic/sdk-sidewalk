## prj.conf
```kconfig
#
# Copyright (c) 2023 Nordic Semiconductor ASA
#
# SPDX-License-Identifier: LicenseRef-Nordic-5-Clause
#

# Sidewalk
CONFIG_SIDEWALK=y


# This sample do not require DFU, disable it
CONFIG_SIDEWALK_DFU=n

# Logs
CONFIG_SIDEWALK_LOG_LEVEL_OFF=y
CONFIG_SIDEWALK_BLE_ADAPTER_LOG_LEVEL_DBG=y

CONFIG_NVS_LOG_LEVEL_WRN=y
CONFIG_LOG_PRINTK=y

# Bluetooth
CONFIG_BT_DEVICE_NAME="Sid dut"

# Debug
CONFIG_RESET_ON_FATAL_ERROR=n
CONFIG_THREAD_NAME=y
CONFIG_THREAD_MONITOR=y
CONFIG_THREAD_STACK_INFO=y


CONFIG_NVS_LOOKUP_CACHE=y
CONFIG_NVS_LOOKUP_CACHE_SIZE=1024

CONFIG_SPIN_VALIDATE=n

# Disable additional data buffering in SPI driver.
CONFIG_SPI_NRFX_RAM_BUFFER_SIZE=0
```

## src/main.c
```c
/*
 * Copyright (c) 2023 Nordic Semiconductor ASA
 *
 * SPDX-License-Identifier: LicenseRef-Nordic-5-Clause
 */

#include <zephyr/logging/log.h>

#include <sidewalk_version.h>

#include <sid_error.h>
#include <sid_dut_shell.h>
#include <sid_thread.h>

LOG_MODULE_REGISTER(sid_main, LOG_LEVEL_INF);

int main(void)
{
	PRINT_SIDEWALK_VERSION();

	initialize_sidewalk_shell(sid_thread_get_config(), sid_thread_get_app_context());

	sid_error_t e = sid_thread_init();

	if (e != SID_ERROR_NONE) {
		LOG_ERR("sidwalk failed to initialize with error (sid_error_t) %d", e);
	}
	LOG_INF("fake PR");
	return 0;
}
```
